## config/west.yml
```yaml
manifest:
  remotes:
    - name: zmkfirmware
      url-base: https://github.com/zmkfirmware
    - name: petejohanson
      url-base: https://github.com/petejohanson
  projects:
    - name: zmk
      remote: zmkfirmware
      # revision: v0.1.0
      # right before the release of pandakb's firmware
      revision: bac6bda34c5165d15770868f2028b064f4665c49
      import: app/west.yml
  self:
    path: config
```
